## Bubu_Motion/sdkconfig.defaults.round_i80
```kconfig
CONFIG_BOARD_TYPE_ESP32S3_128_ROUND_I80=y
CONFIG_LANGUAGE_EN_US=y
CONFIG_FLASH_CUSTOM_ASSETS=y
CONFIG_CUSTOM_ASSETS_FILE="assets.bin"
CONFIG_USE_CUSTOM_WAKE_WORD=y
CONFIG_SR_MN_EN_MULTINET5_SINGLE_RECOGNITION_QUANT8=y
CONFIG_ESP_CONSOLE_USB_SERIAL_JTAG=y
# CONFIG_ESP_CONSOLE_UART_DEFAULT is not set
CONFIG_LV_FONT_MONTSERRAT_48=y
# CONFIG_MQTT_STRICT_UPSTREAM_SEQUENCE is not set
```
